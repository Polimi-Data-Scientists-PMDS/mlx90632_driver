## drivers/sensor/melexis/mlx90632/Kconfig
```kconfig
# Copyright (c) Michele Tavecchio <tavecchiomichele03@gmail.com>, 
# Alessandro Sola <alessandrosola03@gmail.com>,
# Melexis Technologies NV
#
# SPDX-License-Identifier: Apache-2.0


config MLX90632
    bool "MLX90632 Infrared Temperature Sensor"
	default y
	depends on DT_HAS_MELEXIS_MLX90632_ENABLED
    select I2C
	help
	  Enable driver for MLX90632 infrared temperature sensor.
```

## dts/bindings/sensor/melexis,mlx90632.yaml
```yaml
# Copyright (c) 2026 Michele Tavecchio <tavecchiomichele03@gmail.com>, 
# Alessandro Sola <alessandrosola03@gmail.com>,
# Melexis Technologies NV
#
# SPDX-License-Identifier: Apache-2.0

description: |
    Melexis MLX90632 Infrared Temperature Sensor. See datasheet at
    https://www.melexis.com/en/documents/documentation/datasheets/datasheet-mlx90632

compatible: "melexis,mlx90632"

include: [sensor-device.yaml, i2c-device.yaml]
```
